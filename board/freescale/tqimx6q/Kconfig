## board/freescale/tqimx6q/Kconfig
```kconfig
if TARGET_TQIMX6Q

config SYS_BOARD
	default "tqimx6q"

config SYS_VENDOR
	default "freescale"

config SYS_SOC
	default "mx6"

config SYS_CONFIG_NAME
	default "tqimx6q"

endif
```

## configs/tqimx6q_defconfig
```kconfig
CONFIG_SYS_EXTRA_OPTIONS="IMX_CONFIG=board/freescale/tqimx6q/mx6q_4x_mt41j128.cfg,MX6Q"
CONFIG_ARM=y
CONFIG_TARGET_TQIMX6Q=y
CONFIG_DM=y
CONFIG_DM_THERMAL=y
```
